## modules/ultrawidelock_cred/Kconfig
```kconfig
# UltraWideLock credential-auth stack — the open replacement for the closed
# libaliro/libaliro_ble reader engine. Shared by the ESP32-S3 port (where it is
# the only implementation) and, behind this option, the nRF5340 build.
#
# Distinct from ULTRAWIDELOCK_CRED in modules/ultrawidelock_uwb, which names the CCC/STS *ranging*
# engine below this layer and is unrelated.

config ULTRAWIDELOCK_PRIM
	bool
	default y if ULTRAWIDELOCK_CRED_STACK
	default y if ULTRAWIDELOCK_CRED
	default y if ULTRAWIDELOCK_SEALED_LINK
	default y if ULTRAWIDELOCK_DFU_RECEIVER
	help
	  Build the image's single PSA implementation of the portable primitive
	  contract. This is internal plumbing shared by the credential stack, CCC
	  ranging, sealed peer links and DFU signature verification; it has no
	  user-facing policy of its own.

config ULTRAWIDELOCK_CRED_STACK
	bool "UltraWideLock credential-auth stack (open libaliro replacement)"
	help
	  Compile the open credential reader core: the credential-auth key schedule
	  (X9.63/HKDF -> session keys, URSK, BleSK), the AES-256-GCM secure
	  channel, the BER-TLV/ISO7816 wire codec, and the reader trust store.

	  This builds the platform-agnostic core only. It provides no BLE
	  transport and does not displace libaliro on its own; the nRF5340 build
	  still links the closed archive.

config ULTRAWIDELOCK_CRED_DEV_TRUST
	bool "LAB ONLY: accept credentials with an empty dev trust store"
	help
	  Permit the built-in development identity to authenticate a presented
	  credential when no trust anchors exist. This bypass is for isolated lab
	  bring-up only. Production and release images must leave it disabled.

config ULTRAWIDELOCK_CRED_STEPUP
	bool "Credential step-up (Access Document) phase"
	help
	  Build the Aliro v1.0 §8.4 step-up phase into the reader: after the
	  standard EXCHANGE the reader can request an ISO 18013-5 Access Document
	  from the user device (ENVELOPE / GET RESPONSE APDUs carrying a
	  session-encrypted DeviceRequest/DeviceResponse) and verify it per §7.4.

	  This is what admits a device the Matter hub never sent a SetCredential
	  for -- an Apple Watch on the owner's Apple ID, in every field log so
	  far. A presented key no anchor matches is asked for its document while
	  an issuer key (SetCredential type 6) is held; only a document a stored
	  issuer signed over that very key learns it as an evictable anchor, and
	  the unlock waits on that verdict. Without this option such a key is
	  rejected at AUTH1, as before. Costs about 4.5 KiB of static RAM, shared
	  by every session: the collected document, its decrypted form, and the
	  parsed document (whose capacity the app may trim with
	  ULTRAWIDELOCK_STEPUP_MAX_DIGESTS / _ITEMS below).

config ULTRAWIDELOCK_CRED_STEPUP_BENCH
	bool "Bench one-shot step-up (ultrawidelock-stepup arm)"
	depends on ULTRAWIDELOCK_CRED_STEPUP
	help
	  The console-armed one-shot: the next already-trusted phone is asked for
	  its Access Document and the verdict is verified on a background worker
	  and logged, never gating access. Needs a console to arm it from and a
	  port-supplied worker (ultrawidelock_stepup_worker_submit / _last), which
	  the DWM3001CDK image has neither of, so it stays off there.

config ULTRAWIDELOCK_CRED_STEPUP_SD_MAX
	int "Step-up DeviceResponse collection buffer (bytes)"
	depends on ULTRAWIDELOCK_CRED_STEPUP
	default 1536
	help
	  Static RAM for the one SessionData DeviceResponse the reader collects
	  across the 61XX chain, shared by every session. A document that outgrows
	  it is dropped, never verified gapped. The bench worker's job copy must
	  be at least this large (checked at compile time).

config ULTRAWIDELOCK_STEPUP_MAX_DIGESTS
	int "Step-up parser: value digests kept per document"
	depends on ULTRAWIDELOCK_CRED_STEPUP
	default 24
	help
	  Capacity of the parsed document's digest table (32 bytes each, static
	  RAM). Digests past it are counted in the verdict, not treated as a parse
	  error. The spec example carries 3.

config ULTRAWIDELOCK_STEPUP_MAX_ITEMS
	int "Step-up parser: disclosed items kept per document"
	depends on ULTRAWIDELOCK_CRED_STEPUP
	default 16
	help
	  Capacity of the parsed document's item table (static RAM). Items past
	  it are counted in the verdict, not treated as a parse error. The spec
	  example carries 1.

config ULTRAWIDELOCK_CRED_HOUSEKEEPING_STACK_SIZE
	int "Credential housekeeping thread stack size"
	depends on ULTRAWIDELOCK_CRED_STACK
	range 2048 8192
	default 3072
	help
	  Static stack, in bytes, for deferred P-256 spare generation and
	  provisioning persistence. Keep this low-priority worker large enough for
	  the selected crypto and settings backends; validate changes with target
	  stack instrumentation.

module = ULTRAWIDELOCK_CRED
module-str = ultrawidelock_cred
source "subsys/logging/Kconfig.template.log_config"
```
