## CMakeLists.txt
```
# DWM3001CDK standalone credential lock: the reader engine, the CCC/FiRa responder,
# the DW3110 driver and the BLE stack in one nRF52833 image.
#
# ultrawidelock_uwb and modules/ultrawidelock_dw3000 come in as Zephyr modules because they carry their own
# Kconfig gating. modules/ultrawidelock_cred's reader core is listed
# directly here, the way tests/on_target/zephyr/nrf5340dk-ultrawidelock-device-ec does, so the nRF5340 build
# that consumes that module through CONFIG_ULTRAWIDELOCK_CRED_STACK stays untouched.
cmake_minimum_required(VERSION 3.20.0)

get_filename_component(REPO_ROOT "${CMAKE_CURRENT_LIST_DIR}/../.." ABSOLUTE)
# modules/ultrawidelock_cred supplies this app's Kconfig and its named primitive
# provider. The reader sources remain listed directly below; keeping
# CONFIG_ULTRAWIDELOCK_CRED_STACK=n prevents the credential library from being
# compiled a second time.
# modules/ultrawidelock_anchor is listed on the same terms: its CMakeLists is gated on
# CONFIG_ULTRAWIDELOCK_ANCHOR, which is default n, so listing it here costs the default
# build nothing and only makes `overlay-anchor.conf` able to turn it on.
# modules/ultrawidelock_ml likewise, gated on CONFIG_ULTRAWIDELOCK_ML_LOS: default n, so the shipping
# image is byte-identical without it and only overlays/mlgate.conf turns it on.
list(APPEND ZEPHYR_EXTRA_MODULES
	"${REPO_ROOT}/modules/ultrawidelock_cred"
	"${REPO_ROOT}/modules/ultrawidelock_anchor"
	"${REPO_ROOT}/modules/ultrawidelock_matter"
	"${REPO_ROOT}/modules/ultrawidelock_ml"
	"${REPO_ROOT}/modules/ultrawidelock_uwb"
	"${REPO_ROOT}/modules/ultrawidelock_dw3000"
	"${REPO_ROOT}/ports/zephyr")

find_package(Zephyr REQUIRED HINTS $ENV{ZEPHYR_BASE})
project(ultrawidelock_reader_dwm3001cdk)

# Faster UWB evidence settings are measurements, not release policy. Refuse a
# configuration that could lower either floor without both explicit bench
# acknowledgement and strict STS enforcement.
if((CONFIG_ULTRAWIDELOCK_RANGE_TRUST_K LESS 3 OR
    CONFIG_ULTRAWIDELOCK_APPROACH_NEAR_DWELL LESS 2) AND
   (NOT CONFIG_ULTRAWIDELOCK_BENCH OR NOT CONFIG_ULTRAWIDELOCK_RANGE_GATE_STRICT))
	message(FATAL_ERROR
		"Reduced UWB consensus/dwell requires CONFIG_ULTRAWIDELOCK_BENCH=y "
		"and CONFIG_ULTRAWIDELOCK_RANGE_GATE_STRICT=y")
endif()

# APPROTECT must never be locked on this board. SystemInit() re-asserts the lock
# on every boot and the only way out is `nrfjprog --recover`, which mass-erases
# flash AND UICR -- taking settings_storage at 0x7c000 with it, and with that the
# reader private key and every iPhone key already provisioned against this board.
#
# This is the configure-time half of the guard: it fails the build of THIS image
# before a hex exists. scripts/check-approtect.sh is the other half and is the
# one that covers MCUboot, whose config lives outside this CMakeLists entirely.
# Both are needed -- the setting can arrive from a board defconfig or an SoC
# default that no grep of this tree would find, which is why the check that
# matters reads the GENERATED .config.
if(CONFIG_NRF_APPROTECT_LOCK OR CONFIG_NRF_SECURE_APPROTECT_LOCK)
	message(FATAL_ERROR
		"APPROTECT lock is enabled for this image. Refusing to build.\n"
		"  CONFIG_NRF_APPROTECT_LOCK        = ${CONFIG_NRF_APPROTECT_LOCK}\n"
		"  CONFIG_NRF_SECURE_APPROTECT_LOCK = ${CONFIG_NRF_SECURE_APPROTECT_LOCK}\n"
		"Locking is a one-way door for this board's DATA: recovering debug "
		"access costs a mass erase of flash and UICR, which destroys "
		"settings_storage and the reader identity. Export it first with "
		"`ultrawidelock export yes` if you genuinely intend this.")
endif()

set(CRED "${REPO_ROOT}/modules/ultrawidelock_cred")
set(PORTZ "${REPO_ROOT}/ports/zephyr")

# Reader-role source sets come from the role manifests (modules/ultrawidelock_cred/
# roles/*.list) — the same lists the ESP32 components, the nRF5340 apps and the
# host suite read, so each role's file set exists in exactly one place. The
# crypto role is composition only; this image's PSA implementation is the
# named ultrawidelock_prim library contributed by the credential module.
include("${REPO_ROOT}/cmake/ultrawidelock_roles.cmake")
ultrawidelock_role_sources("${CRED}/roles/reader.list" ULTRAWIDELOCK_READER_SRCS)
ultrawidelock_role_sources("${CRED}/roles/reader_policy.list" ULTRAWIDELOCK_POLICY_SRCS)
ultrawidelock_role_sources("${CRED}/roles/apdu.list" ULTRAWIDELOCK_APDU_SRCS)
ultrawidelock_role_sources("${CRED}/roles/crypto.list" ULTRAWIDELOCK_CRYPTO_SRCS)
ultrawidelock_role_sources("${CRED}/roles/hash.list" ULTRAWIDELOCK_HASH_SRCS)
ultrawidelock_role_sources("${CRED}/roles/dyntag.list" ULTRAWIDELOCK_DYNTAG_SRCS)
ultrawidelock_role_sources("${CRED}/roles/ble_central.list" ULTRAWIDELOCK_BLE_CENTRAL_SRCS)

target_sources(app PRIVATE
	src/main.c
	src/ml_feed.c
	# Platform seams the reader engine links against, re-homed to ports/zephyr
	# with the rest of the Zephyr glue. Listed by path rather than compiled by
	# the ultrawidelock_zephyr_port module because they are unconditional app glue with
	# no Kconfig gate to ride — this app IS the gate.
	${PORTZ}/ble/ultrawidelock_ble_zephyr.c
	${PORTZ}/store/ultrawidelock_prov_settings.c
	# Reader engine: roles reader + reader_policy + apdu + crypto + hash + dyntag.
	${ULTRAWIDELOCK_READER_SRCS}
	${ULTRAWIDELOCK_POLICY_SRCS}
	${ULTRAWIDELOCK_APDU_SRCS}
	${ULTRAWIDELOCK_CRYPTO_SRCS}
	${ULTRAWIDELOCK_HASH_SRCS}
	${ULTRAWIDELOCK_DYNTAG_SRCS}
)
target_link_libraries(app PRIVATE ultrawidelock_prim)
if(CONFIG_ULTRAWIDELOCK_CRED_STEPUP)
	# The step-up (Access Document) phase: the verifier plus the wire codecs
	# role (DeviceResponse parser, SessionData/ENVELOPE codecs). Compiled the
	# way the ESP32 reader component compiles them; ultrawidelock_stepup.c is
	# allowlisted as NOT_MANIFESTED in tests/tooling/port_purity_check.sh.
	ultrawidelock_role_sources("${CRED}/roles/wire_codecs.list" ULTRAWIDELOCK_WIRE_CODEC_SRCS)
	target_sources(app PRIVATE
		"${CRED}/src/ultrawidelock_stepup.c"
		${ULTRAWIDELOCK_WIRE_CODEC_SRCS}
	)
	# This part is out of both RAM and flash (nRF52833: 128 KiB / 423.5 KiB app
	# slot, 98% of each before step-up). The parsed document's capacity is
	# trimmed in prj.conf (CONFIG_ULTRAWIDELOCK_STEPUP_MAX_DIGESTS / _ITEMS).
	# LEAN drops what this reader never reads from the document -- the
	# COSE alg label and the x5chain (only a provisioned issuer may vouch)
	# -- and the lines that print a rejected document's operands. It used
	# to drop the validity dates too, for about 0.6 KiB in all; a Watch's
	# document requires time verification and cannot pass without them.
	target_compile_definitions(app PRIVATE
		ULTRAWIDELOCK_STEPUP_LEAN=1
	)
endif()
if(CONFIG_ULTRAWIDELOCK_BENCH_CRED_O2)
	set_source_files_properties(
		"${CRED}/src/ultrawidelock_reader.c"
		"${CRED}/src/ultrawidelock_crypto.c"
		"${CRED}/src/ultrawidelock_hash.c"
		PROPERTIES COMPILE_OPTIONS "-O2")
	target_compile_options(ultrawidelock_prim PRIVATE -O2)
endif()
# Provisioning console (USB CDC-ACM, provisioning mode only). Dropped by
# 4bdfd44a, which replaced this line with the side_feed one below instead of
# adding it, and so deleted `ultrawidelock import/export/erase` from every build
# without deleting the file or the comment. Restored, and the two lines are kept
# apart so the next edit here cannot repeat it.
target_sources_ifdef(CONFIG_ULTRAWIDELOCK_PROV_CONSOLE app PRIVATE src/prov_shell.c)

# Bench commands typed at the RTT terminal (`trust`, `prov`): the only input
# this image has, since the USB console above is off in the Matter build.
target_sources(app PRIVATE src/rtt_bench.c)

# The side gate's bench feed: an RTT buffer drained by host tooling.
target_sources_ifdef(CONFIG_ULTRAWIDELOCK_SIDE_GATE app PRIVATE src/side_feed.c)
# The deployed witness transport. Separate from SIDE_GATE's bench feed: this
# one binds a Thread socket instead of draining an RTT buffer, so it is gated
# on its own symbol and the RTT path stays available for bench work.
target_sources_ifdef(CONFIG_ULTRAWIDELOCK_SEALED_LINK app PRIVATE src/witness_link.c)
# Measurement only; CONFIG_ULTRAWIDELOCK_THREAD_GATE defaults n so this is absent from
# every shipping image.
target_sources_ifdef(CONFIG_ULTRAWIDELOCK_THREAD_GATE app PRIVATE src/thread_gate.c)
# The two DoorLockAlarms, and the door-angle state they need. ANCHOR is default
# n, so the shipping image never compiles this. Both symbols, not just ANCHOR:
# the alarm is a Matter event, and `make reader ANCHOR=1` is an anchor build
# with no Matter node to carry one.
if(CONFIG_ULTRAWIDELOCK_ANCHOR AND CONFIG_ULTRAWIDELOCK_MATTER_BLE)
	target_sources(app PRIVATE src/door_alarm.c)
endif()
# The DFU receiver's BLE transport (ports/zephyr/dfu/dfu_ble_zephyr.c) and the
# rest of the gated Zephyr glue compile via the ultrawidelock_zephyr_port module under
# the same CONFIG symbols.
# The board's only output. NOT gated on the DFU receiver any more: the update
# window was the first thing worth showing, not the only one, and the `reader`
# image has no receiver and used to light nothing at all.
target_sources_ifdef(CONFIG_ULTRAWIDELOCK_STATUS_LED app PRIVATE src/status_led.c)
target_sources_ifdef(CONFIG_ULTRAWIDELOCK_CIRDIAG_CAPTURE app PRIVATE src/cirdiag_capture.c)
target_sources_ifdef(CONFIG_ULTRAWIDELOCK_CASE_BENCH app PRIVATE src/case_bench.c)
# Initiator (User-Device role) transport: ultrawidelock_zephyr_port compiles the central
# mirror of ultrawidelock_ble_zephyr.c under this gate; the platform-free advert/READ
# decoder it calls is the same translation unit the ESP32 port and the host
# suite compile.
target_sources_ifdef(CONFIG_ULTRAWIDELOCK_BLE_CENTRAL app PRIVATE ${ULTRAWIDELOCK_BLE_CENTRAL_SRCS})
# The commissioning policy half; its transport, Thread/fabric ports and fabric
# table store live in ports/zephyr/{matter,store} under the same gate.
target_sources_ifdef(CONFIG_ULTRAWIDELOCK_MATTER_BLE app PRIVATE
	src/matter_commission.c
	src/uwb_matter_presence.c)
# The client role: what turns the four protocol files in ultrawidelock_matter
# into a lock that unlocks another lock. Both symbols, not just the client one,
# for the same reason door_alarm.c needs both above: the routing hooks it
# depends on live in matter_commission.c.
if(CONFIG_ULTRAWIDELOCK_MATTER_CLIENT AND CONFIG_ULTRAWIDELOCK_MATTER_BLE)
	target_sources(app PRIVATE src/matter_client.c)
endif()

# CONFIG_MBEDTLS_MEMORY_DEBUG=y is a NO-OP in this build and sets no define.
# nrf_security only wires that symbol through configs/legacy_crypto_config.h.template
# (`#cmakedefine MBEDTLS_MEMORY_DEBUG`, line 1268); a PSA-only build
# (CONFIG_OBERON_ONLY_PSA_ENABLED) generates nrf-config.h from a different
# template that has no slot for it, so the Kconfig is accepted and silently
# dropped. The app then compiles against a declaration the library never
# defined and the link fails on mbedtls_memory_buffer_alloc_max_get.
#
# Define it for every target instead. Safe because the only struct it changes,
# buffer_alloc_ctx, is file-local to mbedtls/library/memory_buffer_alloc.c, so
# there is no layout to get out of step across compilation units.
if(CONFIG_ULTRAWIDELOCK_HEAP_PROBE)
	zephyr_compile_definitions(MBEDTLS_MEMORY_DEBUG)
endif()
# src for matter_commission.h (included by the re-homed ultrawidelock_ble_zephyr.c);
# ${PORTZ}/{matter,store} for the re-homed matter_ble_zephyr.h and
# matter_fab_settings.h, which main.c and matter_commission.c include
# regardless of CONFIG_ULTRAWIDELOCK_MATTER_BLE.
target_include_directories(app PRIVATE ${CRED}/include ${CRED}/src src
	${PORTZ}/matter ${PORTZ}/store)
```

## prj.conf
```kconfig
# DWM3001CDK standalone credential reader.
#
# The whole file is written against one constraint: 480 KB of code space, from
# the single-image partition layout in boards/decawave_dwm3001cdk.overlay. The
# stock board map would have given the app 224 KB, which is not enough. Every
# "=n" below is load-bearing, not tidiness.

CONFIG_SIZE_OPTIMIZATIONS=y

# The partition map has one application slot, so MCUboot has no sector-swap
# status to store. Keep imgtool's overflow check aligned with that mode: one
# sector reserves 60 B, still 12 B above MCUboot's 48 B runtime trailer. The
# default 128-sector check reserves 1,584 B for a swap this layout cannot do.
CONFIG_MCUBOOT_EXTRA_IMGTOOL_ARGS="--max-sectors 1"

# One-shot application -> MCUboot recovery request in nRF52833 GPREGRET2.
# A normal boot performs no wait; the runtime SW2 hold sets this byte first.
CONFIG_RETAINED_MEM=y
CONFIG_RETENTION=y
CONFIG_RETENTION_BOOT_MODE=y

# ---- BLE: peripheral only, one connection, no bonding -----------------------
# credential runs its own application-layer secure channel over the L2CAP CoC, so
# BLE pairing/bonding buys nothing and costs both flash and a walk-up prompt.
# The shipped ESP32-S3 reader is unpaired for the same reason and unlocks a
# real iPhone Wallet key.
CONFIG_BT=y
CONFIG_BT_PERIPHERAL=y
CONFIG_BT_CENTRAL=n
CONFIG_BT_OBSERVER=n
CONFIG_BT_BROADCASTER=y
# TWO SLOTS, NOT ONE, AND THE SECOND ONE IS THE UPDATE PATH.
#
# With a single slot the arithmetic is brutal and was not noticed until a board
# was in front of a browser: a connectable advertisement with no free slot would
# be a lie, so the port correctly stops advertising the moment anything connects
# -- and a board that is not advertising is not merely slow to find from Web
# Bluetooth, it is INVISIBLE. requestDevice() shows an empty chooser forever.
#
# So a lock doing its job, with a phone holding the link, could never be updated
# over the air. The one state in which an update is most wanted -- a deployed,
# in-use lock -- was the one state that excluded it. That is not a browser
# limitation and no amount of page work could have reached it.
#
# MEASURED on the bench 2026-08-27 by reading the port's own flags over SWD:
# s_conn_up=1, s_adv_running=0, steady, on a board that was powered, working and
# answering over its cable in the same minute.
#
# MEASURED COST, same tree, this symbol and the port's slot counting the only
# levers, thread+release+smp+lto:
#
#   one slot    406,468 B flash   118,776 B RAM (90.62%)
#   two slots   406,468 B flash   121,728 B RAM (92.87%)
#   cost              +0 B            +2,952 B
#
# That leaves 9,344 B of RAM free, which is the tightest this image has run in
# the shipping configuration -- though not the tightest recorded: the +client
# baseline in size-baseline.json already sits at 93.73%. Worth knowing before
# adding the next thing that wants RAM.
#
# The second slot costs RAM and buys the property the flasher page promises. It
# does NOT weaken anything: BT_MAX_PAIRED stays 0, nothing gains a security
# level, and the L2CAP server and GATT permissions are untouched. Two peers can
# now be connected at once, which is what lets an update happen next to a phone
# rather than instead of one.
CONFIG_BT_MAX_CONN=2
CONFIG_BT_MAX_PAIRED=0
# SMP is compiled in only because Zephyr makes L2CAP CoC depend on it
# (zephyr/subsys/bluetooth/host/Kconfig.l2cap:49) — NimBLE does not, which is
# why the ESP32 port never needed this. It is never exercised: the GATT
# characteristics carry no _ENC/_AUTHEN permission, the L2CAP server sits at
# BT_SECURITY_L1, and nothing calls bt_conn_set_security. So the reader still
# never asks a phone to pair, which is the property the live-iPhone unlock
# depends on. Costed at stage 0 rather than assumed away.
CONFIG_BT_SMP=y
CONFIG_BT_BONDABLE=n
CONFIG_BT_SIGNING=n
CONFIG_BT_GATT_CACHING=n
# The 0xFFF6 commissioning service is registered and withdrawn at runtime so
# the GATT table matches the advert -- see matter_ble_publish(). That is the
# only dynamic service on the board; everything else stays static.
#
# NOT A TIDINESS CHANGE. macOS refuses third-party descriptor discovery on the
# Matter UUIDs, Chromium's macOS backend never completes discovery after that
# error, and so a published 0xFFF6 costs this board every Web Bluetooth client
# on that host -- SMP firmware updates over the air included.
CONFIG_BT_GATT_DYNAMIC_DB=y
CONFIG_BT_DEVICE_NAME="ultrawidelock"

# Observe what the controller and peer actually negotiated. USER_* exposes the
# callbacks; stating AUTO_DATA_LEN_UPDATE keeps Zephyr's prior automatic DLE
# policy after USER_DATA_LEN_UPDATE is enabled. Shipping still requests no PHY
# change and keeps the controller data-length maximum at its 27-byte default;
# the 2M and 251-byte experiments live only in bench overlays.
CONFIG_BT_USER_DATA_LEN_UPDATE=y
CONFIG_BT_AUTO_DATA_LEN_UPDATE=y
CONFIG_BT_USER_PHY_UPDATE=y

# Connection interval: ask for 15-30 ms instead of riding whatever iOS picks.
#
# Every BLE flow on this board is round-trip bound, and one of them pays triple:
# the 255 B ACL buffer below splits a 512 B credential APDU across three PDUs, so an
# APDU costs up to three connection events in each direction. BTP fragments,
# CoC APDUs and DFU chunks all scale straight off the interval.
#
# This is Kconfig rather than a bt_conn_le_param_update() call BECAUSE of how
# the Zephyr peripheral works: that call does NOT send anything while the
# post-connect timer is still pending (host/conn.c:3786) -- it only stores the
# parameters for the timer to use. The request goes out when
# BT_CONN_PARAM_UPDATE_TIMEOUT fires, so the timeout IS the lever, and the PREF
# values are what gets sent. Adding a call site would have changed nothing.
#
# 300 ms rather than the stock 5,000: the whole walk-up transaction is ~650 ms,
# so a request at 5 s arrives after every flow it could have helped. The link
# layer needs >= 6 connection events of instant delay anyway, so the faster
# interval lands mid-transaction, not at its start.
#
# 12/24/0/200 = 15-30 ms, no latency, 2 s supervision. Valid per
# hci_core.c:1947-1960 and inside Apple's accessory guideline (min >= 15 ms,
# max >= min + 15 ms).
#
# MEASURED, and the reason the window is back to 12-24 rather than something
# cleverer: this iPhone grants 30 ms whatever it is asked for. Both 12-24 and
# 12-18 (a range whose only multiple of 15 ms is 15) came back as
# "interval 30.00 ms, latency 0, timeout 2000 ms" on 2026-08-06, on the
# commissioning link and again on the walk-up link. It honours the latency and
# the supervision timeout and picks the interval itself, so 30 ms is this
# phone's floor for this accessory and not a thing this end can bargain over.
# What survives is worth keeping -- 2 s of supervision instead of Zephyr's
# 420 ms default, and a request that arrives in time to matter if any other
# central (Android, a Home Assistant host, a controller doing DFU) does grant
# it -- but do not expect a faster walk-up from this knob on iOS.
CONFIG_BT_CONN_PARAM_UPDATE_TIMEOUT=300
CONFIG_BT_PERIPHERAL_PREF_MIN_INT=12
CONFIG_BT_PERIPHERAL_PREF_MAX_INT=24
CONFIG_BT_PERIPHERAL_PREF_LATENCY=0
CONFIG_BT_PERIPHERAL_PREF_TIMEOUT=200

# L2CAP CoC carries the credential transaction. 512-byte SDUs match the ESP port.
CONFIG_BT_L2CAP_DYNAMIC_CHANNEL=y
CONFIG_BT_L2CAP_TX_MTU=512
# Sized for a PDU, not an SDU. The host's HCI receive pool is UNIFIED and gives
# every buffer the largest of the ACL and event sizes (buf.h:165, buf.h:175), so
# a 527 B ACL buffer made all twelve cost 527 B: 6,384 B measured in .bss for a
# geometry only one of them needed. Nothing here reassembles into that pool --
# coc_alloc_buf() hands the host an s_coc_rx_pool buffer of its own and Zephyr
# builds the SDU there. At 255 the MPS falls to ~251, a 512 B SDU rides three
# PDUs instead of one, and the pool costs 3,060 B. The price is two extra
# connection events per credential APDU, which is nothing against a walk-up. BTP is
# untouched: it rides GATT at an ATT MTU of 247, which still fits one PDU.
CONFIG_BT_BUF_ACL_RX_SIZE=255
CONFIG_BT_BUF_ACL_TX_SIZE=251
# NOT raised, and worth a line so it is not tried again. CONFIG_BT_BUF_EVT_RX_SIZE
# cannot change what the controller checks: hci_driver.c compares against
# HCI_RX_BUF_SIZE = BT_BUF_RX_SIZE = MAX(ACL_RX_SIZE + 4, EVT_RX_SIZE + 2), which
# the 255 above already fixes at 259. Measured: raising it to 255 moved nothing
# and cost 752 B of RAM, a quarter of what this image has left.
CONFIG_BT_EATT=n

# ---- crypto -----------------------------------------------------------------
# nRF52833 has no CryptoCell, so PSA lands on the software nrf_oberon backend.
# That is a speed and flash cost, not a blocker. Same PSA_WANT set the nRF5340
# on-target EC self-test proved (tests/on_target/zephyr/nrf5340dk-ultrawidelock-device-ec/prj.conf).
CONFIG_NRF_SECURITY=y
CONFIG_MBEDTLS_PSA_CRYPTO_C=y
CONFIG_MBEDTLS_ENABLE_HEAP=y
# MEASURED, not argued. 16384 was a guess carried from the ESP port and it was
# the largest single object in .bss. With ULTRAWIDELOCK_HEAP_PROBE the peak across boot,
# PASE and a full CASE handshake is 228 B in 11 blocks -- reproduced on two
# independent runs, the second on a fully erased board with a new SRP key and a
# new node id. The Kconfig help for ULTRAWIDELOCK_HEAP_PROBE predicted this: the build
# is OBERON_ONLY_PSA_ENABLED with no MBEDTLS_BIGNUM_C or ECP_C, so ECDH and
# ECDSA run in driver stack buffers and only PSA key-slot material is ever
# mbedtls_calloc'd.
#
# 1024 kept 4.5x the measured peak, and it was not a fresh guess: the reader
# build was rebuilt at exactly that value and a live iPhone still unlocked, on a
# fresh session, for a saving of 15,360 B. CASE's own peak is 380 B, measured by
# ULTRAWIDELOCK_CASE_BENCH, so 1024 covered both users of this heap with room over.
#
# This line used to carry a caution -- "NOT cut to peak+2048: the one path this
# image cannot exercise is a credential unlock, because a Matter build carries no
# reader identity". That premise expired on 2026-08-02, when Apple Home began
# provisioning the reader itself and this image started doing full walk-up
# unlocks. The path the caution was about is now exercised by the very walk-up
# that validates every other RAM change, which is what makes the cut checkable
# rather than merely argued.
#
# 512 WAS TRIED ON 2026-08-03 AND BROKE MATTER OVER THREAD. Do not try it again
# without reading this, because the argument for it looks airtight and the
# failure lands nowhere near the heap.
#
# The 228 B peak above is real and was never wrong. What it does not cover is
# the one allocation this image makes rarely and cannot do without: creating a
# PERSISTENT PSA key. OpenThread's SRP client does exactly that -- this build
# has OPENTHREAD_CONFIG_PLATFORM_KEY_REFERENCES_ENABLE=1, so its ECDSA key is
# generated at PSA_KEY_LIFETIME_PERSISTENT (crypto_psa.c:591), which serialises
# the key, seals it with ChaCha20-Poly1305 and writes it through
# trusted_storage. None of that runs on the boot, PASE or CASE paths the 228 B
# was measured across, and none of it runs for a volatile key.
#
# MEASURED by srp_sign_self_test() in matter_commission.c: at 512 a volatile
# P-256 deterministic-ECDSA key generates, exports, imports and signs perfectly,
# and the identical sequence at persistent lifetime fails inside psa_generate_key
# with psa_status=-141, PSA_ERROR_INSUFFICIENT_MEMORY. Two log lines apart, same
# boot.
#
# WHAT IT LOOKS LIKE WHEN IT BREAKS, because it looks like anything but this.
# The board commissions over BLE, completes PASE, accepts AddNOC, attaches to
# Thread as a child and gets an off-mesh address -- and then never registers its
# name. OpenThread reports one value for it, kErrorFailed, which
# crypto_psa.c:22-34 maps every PSA error onto except two, and which
# dns_types.cpp:52-100 ALSO produces from a server SERVFAIL. So the log says
# "SRP registration FAILED (1) -- the commissioner cannot resolve this node",
# every finger points at the border router, and an afternoon goes into the
# network before anyone suspects a RAM constant.
CONFIG_MBEDTLS_HEAP_SIZE=1024

# PSA PERSISTENT-KEY STORAGE MUST STAY ON. Do not cut it, and here is the
# receipt, because the argument for cutting it is convincing and wrong.
#
# The argument: this image's PSA_WANT list above names no ChaCha, yet the build
# links a whole ChaCha20-Poly1305 -- MEASURED from the map, ocrypto_chacha20
# 874 B + ocrypto_poly1305 1,250 B + ocrypto_chacha20_poly1305 762 B = 2,886 B,
# before the ITS glue on top. It arrives because MBEDTLS_PSA_CRYPTO_STORAGE_C
# pulls in TRUSTED_STORAGE, whose AEAD backend has exactly one cipher choice
# (nrf/subsys/trusted_storage/Kconfig:84-98, no AES-GCM alternative to switch
# to). And nothing in modules/ or apps/dwm3001cdk-lock/src calls psa_set_key_id() or asks
# for PSA_KEY_LIFETIME_PERSISTENT: the reader identity and the Matter fabrics
# are settings-store data owned by ultrawidelock_prov_settings.c and
# matter_fab_settings.c, not by PSA. Total saving, measured: 6,480 B of flash.
#
# Why it is wrong: OPENTHREAD_CRYPTO_PSA=y, so OpenThread's own platform glue
# is the caller this tree cannot see. zephyr/modules/openthread/platform/
# crypto_psa.c:180 imports keys at PSA_KEY_LIFETIME_PERSISTENT, and :591
# generates the SRP ECDSA key that way UNCONDITIONALLY. With the storage gone
# they cannot succeed, and the node cannot hold a network key. Which
# psa_status_t comes back was NOT measured -- the failure below logs no status
# at all -- so do not quote one; the call sites are the evidence.
#
# The failure does not look like a crypto failure. MEASURED 2026-08-03: PASE
# completed, AddNOC returned status 0, the 107 B dataset was accepted, and then
# "Thread still detached after 20000 ms" with the commissioner giving up on the
# BLE link 18 s in. Nothing logged an error, because every layer that could
# have was upstream of the one that failed.
#
# Grep workspace/ before calling a PSA lifetime unused here. The tracked tree is
# not the whole caller set, and this cost a commissioning round to learn.

CONFIG_PSA_WANT_ALG_ECDSA=y
CONFIG_PSA_WANT_ALG_ECDH=y
CONFIG_PSA_WANT_KEY_TYPE_ECC_KEY_PAIR_GENERATE=y
CONFIG_PSA_WANT_KEY_TYPE_ECC_KEY_PAIR_IMPORT=y
CONFIG_PSA_WANT_KEY_TYPE_ECC_KEY_PAIR_EXPORT=y
CONFIG_PSA_WANT_KEY_TYPE_ECC_KEY_PAIR_DERIVE=y
CONFIG_PSA_WANT_KEY_TYPE_ECC_PUBLIC_KEY=y
CONFIG_PSA_WANT_ECC_SECP_R1_256=y
CONFIG_PSA_WANT_ALG_SHA_256=y
# No PSA_WANT_ALG_HKDF here on purpose. It depends on PSA_WANT_ALG_HMAC, which
# this image does not enable, so assigning it only produced a Kconfig warning
# and the value n -- psa_key_derivation_setup() returns PSA_ERROR_NOT_SUPPORTED.
# Nothing missed it: key derivation goes through ultrawidelock_hkdf()
# (modules/ultrawidelock_cred/src/ultrawidelock_hash.c), pure C11 and already linked. Turning the
# PSA one on would cost flash for a second implementation of RFC 5869.
CONFIG_PSA_WANT_ALG_CMAC=y
CONFIG_PSA_WANT_ALG_ECB_NO_PADDING=y
CONFIG_PSA_WANT_ALG_GCM=y
CONFIG_PSA_WANT_KEY_TYPE_AES=y
CONFIG_PSA_WANT_GENERATE_RANDOM=y

# ---- UWB: CCC/FiRa responder on the module's own DW3110 ---------------------
CONFIG_SPI=y
# ports/zephyr/dw3000/dw3000_spi.c uses spi_transceive_signal (the async API),
# same as the nRF5340 build does via scripts/nrf5340dk-build.sh.
CONFIG_SPI_ASYNC=y
CONFIG_DW3000=y
CONFIG_DW3000_CHIP_DW3000=y
CONFIG_ULTRAWIDELOCK_UWB=y
CONFIG_ULTRAWIDELOCK_UWB_RESPONDER=y
# Shipping rejects blocks that fail the calibrated STS-quality gate. Keep the
# module defaults of K=3 and the existing dwell unchanged; hardware calibration
# remains the release gate for the threshold itself.
CONFIG_ULTRAWIDELOCK_RANGE_GATE_STRICT=y
# Single-core SoC: BLE shares the core with the ranging callbacks, so the live
# DS-TWR timestamps get overwritten before Final_Data is processed (km-scale
# garbage). Use the same-round snapshot latched at Final RX, like the ESP path.
CONFIG_ULTRAWIDELOCK_UWB_FINAL_SNAPSHOT=y
CONFIG_ULTRAWIDELOCK_CRED=y
# The step-up phase is how a second device on the owner's Apple ID (a Watch) gets
# in: the hub never sends a SetCredential for it, so the reader asks the device
# for its Access Document and learns the key the home's issuer signed.
CONFIG_ULTRAWIDELOCK_CRED_STEPUP=y
# The parsed document is static RAM: an Access Document carries a handful of
# elements (the spec example has 3 digests and 1 item), so 12 and 8 keep the
# struct near 1.3 KiB instead of 2.2.
CONFIG_ULTRAWIDELOCK_STEPUP_MAX_DIGESTS=12
CONFIG_ULTRAWIDELOCK_STEPUP_MAX_ITEMS=8

# ---- provisioning / trust store ---------------------------------------------
# CONFIG_MPSL_TIMESLOT_SESSION_COUNT is deliberately NOT set here, and it was
# set for a while by mistake. Flash writes do go through an MPSL timeslot on this
# board (SOC_FLASH_NRF_RADIO_SYNC_MPSL), but the driver brings its OWN session:
# mpsl_init.c:205 initialises MPSL with CONFIG_MPSL_TIMESLOT_SESSION_COUNT PLUS
# CONFIG_SOC_FLASH_NRF_RADIO_SYNC_MPSL_TIMESLOT_SESSION_COUNT, and the latter
# already defaults to 1 whenever flash sync is on. Adding one here buys a second
# session context nothing opens.
CONFIG_FLASH=y
CONFIG_FLASH_MAP=y
CONFIG_NVS=y
CONFIG_SETTINGS=y
CONFIG_SETTINGS_NVS=y

# ---- provisioning console (USB CDC-ACM, provisioning mode only) --------------
# The reader identity is per-device data in the settings store, so it has to be
# typed in at runtime. RTT is output-only and the J-Link VCOM belongs to the
# probe, so the input path is the second USB port, which is wired straight to
# the nRF52833. main() calls usb_enable() ONLY when SW2 is held through reset,
# so an operational boot pays the flash for this but never runs a USB interrupt
# next to the DW3110's delayed-TX window.
CONFIG_GPIO=y
CONFIG_SERIAL=y
CONFIG_USB_DEVICE_INITIALIZE_AT_BOOT=n
# The shell and USB sizes that this console needs live in Kconfig under
# CONFIG_ULTRAWIDELOCK_PROV_CONSOLE, with the measurement behind each one. They cannot
# sit here: a .conf assignment is unconditional, so a build that turns the
# console off (a Matter node self-provisions, and reader + console + Thread
# overflows RAM by 1,752 B anyway) would leave them unsatisfiable and NCS aborts
# on the Kconfig warning.
# Logs stay on RTT. CONFIG_LOG_MODE_MINIMAL writes straight to the console and
# does not drive backends, so a shell log backend would cost RAM and deliver
# nothing.
CONFIG_SHELL_LOG_BACKEND=n
CONFIG_SHELL_HISTORY=n
# The `ultrawidelock` command tree here is provisioning only (apps/dwm3001cdk-lock/src/
# prov_shell.c). ultrawidelock_uwb's console of the same name drives a radio that
# provisioning mode never starts.
CONFIG_ULTRAWIDELOCK_UWB_SHELL=n

# ---- what is deliberately absent --------------------------------------------
# Console stays on, but over RTT rather than UART (see logging below).
CONFIG_UART_CONSOLE=n
# MCUboot IS built, and this file no longer decides that: sysbuild.conf does,
# through SB_CONFIG_BOOTLOADER_MCUBOOT. Sysbuild pushes the answer down onto
# this image itself (zephyr/share/sysbuild/image_configurations/
# MAIN_image_default.cmake:8 calls set_config_bool on CONFIG_BOOTLOADER_MCUBOOT),
# and that assignment is applied AFTER prj.conf -- so a `=n` here would not win,
# it would just make this file lie about the image it describes.
#
# What it used to say, kept because the mechanism is still true and still the
# thing that surprises people: CONFIG_BOOTLOADER_MCUBOOT is what produces the
# flash map, not the DTS. With it off, Partition Manager gave `app`
# 0x0..0x7e000 (504 KB) and ignored the 224 KB dual-slot layout in the board
# DTS entirely. With it on, PM builds a bootloader map instead -- and because
# `app` no longer starts at 0 and must not swallow settings_storage, the map is
# now PINNED in pm_static.yml rather than derived. See that file for the sizes
# and boards/decawave_dwm3001cdk.overlay for why the DTS partition nodes remain
# inert either way.
#
# The application still has no SMP server: recovery lives in the bootloader,
# reachable at boot over the J-Link VCOM, and an operational image that also
# spoke mcumgr would be a second write path into its own flash for no gain.
CONFIG_MCUMGR=n

# ---- logging ----------------------------------------------------------------
# RTT, not UART: the delayed-TX reply window on this single-core part cannot
# afford a blocking console write. Minimal mode drops the deferred-logging
# machinery, which is the part that actually costs flash.
CONFIG_LOG=y
CONFIG_LOG_MODE_MINIMAL=y
CONFIG_LOG_DEFAULT_LEVEL=3
# Three of Zephyr's own modules below that default, because what they print is
# not about this lock and every image here is within a few hundred bytes of
# its slot. The Bluetooth host's INFO lines are its boot banner (controller
# build, HCI and LMP versions, identity); its warnings and errors stay. The I2C
# and sensor drivers only ever speak for the LIS2DH12, and the line that
# matters about it is the application's own "no impact sensor; tamper
# detection is off". MEASURED 2026-10-04 on the two-anchor image at main
# 2748b66a: 433,432 B to 431,268 B, 2,164 B back. That is what let the
# credential-status fix and the document dates in (about 1.3 KiB together).
CONFIG_BT_LOG_LEVEL_WRN=y
CONFIG_I2C_LOG_LEVEL_OFF=y
CONFIG_SENSOR_LOG_LEVEL_OFF=y
CONFIG_USE_SEGGER_RTT=y
CONFIG_RTT_CONSOLE=y
# 8 KB up-buffer, not the 1 KB default. RTT is this board's ONLY console, and
# the default policy is NO_BLOCK_SKIP: once the buffer fills, writes are
# silently DISCARDED. Boot output here exceeds 1 KB, so the default truncates
# mid-line and looks exactly like a hang -- it cost a debugging detour to learn.
# Deliberately not BLOCK_IF_FIFO_FULL: that never drops a byte, but it stalls
# the firmware forever when no debugger is draining the buffer.
CONFIG_SEGGER_RTT_BUFFER_SIZE_UP=8192
# Re-initialize the RTT control block unconditionally. The default here is
# STRONG_CHECK -- and it is the default precisely BECAUSE the RTT data sits in
# a custom section (zephyr/modules/segger/Kconfig:120), whose whole purpose is
# to "avoid re-init of Control Block if another program (e.g. bootloader) has
# already initialized it". That assumes a cooperative bootloader. Ours is not
# one: MCUboot here has no LOG, no PRINTK and no USE_SEGGER_RTT, so it never
# initializes RTT -- it just uses that RAM as ordinary BSS and stack.
#
# And it is the SAME RAM. segger_rtt.ld places the section (NOLOAD) sorted to
# RAM start, so the ring lands at 0x20000010 and the control block at
# 0x20002010, while MCUboot's own _image_ram_end is 0x200049c0. The bootloader
# spans both. Without this line the application finds a control block it
# declines to touch and streams MCUboot's leftover RAM to the console as
# binary garbage interleaved with real log lines.
#
# The cost is that the ring no longer survives a reset. That was already gone:
# MCUboot overwrites it on every boot, before this image runs at all.
CONFIG_SEGGER_RTT_INIT_MODE_ALWAYS=y

CONFIG_MAIN_STACK_SIZE=4096
CONFIG_SYSTEM_WORKQUEUE_STACK_SIZE=4096
CONFIG_HEAP_MEM_POOL_SIZE=4096
```

## overlay-anchorlink.conf
```kconfig
# The lock half of the two-anchor inside/outside product.
#
# Turns on the WV3 receive path: a sealed, replay-checked distance from the
# satellite (apps/satellite) reaches ultrawidelock_satellite_report()
# and is paired with this node's own measurement of the SAME ranging block. Two
# distances to one phone in one block is what makes a side decision possible.
#
# Needs the latch overlay alongside it, and that is a current limitation rather
# than a design choice: witness_link.c still holds the WV2 consumer inline, so
# the sealed link does not link without it (see ULTRAWIDELOCK_ANCHOR_LINK's help).
#
# Enrolling the key is a two-step dance because the Thread image has no shell:
#   1. flash the READER image, `ultrawidelock anckey <hex32>` over USB CDC
#   2. flash this image WITHOUT --erase, so the settings partition survives
# Give the satellite the same 32 hex characters with `sat key`.
#
# Build:
#   make build LATCH=1 CDK_BUILD=build/cdk-anchorlink \
#     CDK_CONF="overlay-thread.conf;overlay-latch.conf;overlays/bench-2resp.conf;\
#               overlay-anchorlink.conf;overlay-lto.conf"
# or just `make anchorlink`, which spells exactly that.
#
# THIS FILE CARRIES NO BENCH CALIBRATION. The anchor separation, the range
# bias and the frontier offset are properties of where the two boards are
# mounted, so they stay at their shipping Kconfig defaults here and a real
# install sets them. overlays/bench-anchorlink.conf layers this desk's numbers
# on top for bench work; never flash that on a door.
CONFIG_ULTRAWIDELOCK_ANCHOR_LINK=y

# bench-2resp.conf turns the console SAT-HANDOFF line on for `sat join` by
# hand; once the sealed link exists it carries the same handoff itself
# (cherry_ccc_shim.c calls it redundant), so the print only costs flash and
# discloses the URSK.
CONFIG_ULTRAWIDELOCK_SATELLITE_HANDOFF_LOG=n

# The console is RTT and nothing on this image opens a UART, so the serial
# driver stack is dead weight the linker cannot prove dead. Freed the room
# the channel classifier (overlays/mlgate.conf) needs to fit the MCUboot
# slot. If a UART consumer ever joins this stack, drop this line first.
CONFIG_SERIAL=n

# This production-style image keeps credential errors but drops the
# reader/ranging/BLE warnings and INFO trace. The two-anchor bench receipts
# (pair, witness, replay and fail-closed decisions) use their own modules and
# remain. Besides avoiding credential chatter on a console-less image, this
# recovers the MCUboot slot margin that Matter binding consumed; signing, not
# the linker's region percentage, is the final size gate.
#
# It kept credential WARNINGS too until step-up (a Watch learned from its
# Access Document) came in. MEASURED 2026-09-11, with step-up on and the reader
# at WRN, the image overflowed FLASH by 3,692 B. This line with DFU and DW3000
# at WRN bought back 3,636 B; DFU and DW3000 at ERR plus five matter_ble
# bookkeeping lines demoted to DBG (Sigma1 resend, Sigma2 out, DUP replay,
# subscriptions held, reader configuration restored) left the image signing
# with 678 B clear. Signing needs ~210 B the linker does not count. A walk-up
# that fails without saying why is diagnosed on the plain image.
CONFIG_ULTRAWIDELOCK_CRED_LOG_LEVEL_ERR=y
CONFIG_ULTRAWIDELOCK_DFU_LOG_LEVEL_ERR=y
CONFIG_DW3000_LOG_LEVEL_ERR=y

# Sized from measured jitter, which is what the Kconfig help asks for and the
# 90 default never was. Stage C put per-anchor sigma at 61-68 mm, so the
# DIFFERENCE of two anchors carries sigma ~= 92 mm and 250 is a shade under
# 3 sigma. This widens what counts as a possible pair; it does NOT rescue a
# pair that breaks the triangle inequality outright, which is what body
# blocking produces and what the gate must keep refusing.
CONFIG_ULTRAWIDELOCK_ANCHOR_TOL_MM=250
```

## overlay-client-debug.conf
```kconfig
# Room for the Matter CLIENT in a DEBUG image.
#
#   make build CLIENT=1
#
# Applied automatically for CLIENT=1 without RELEASE=1, because without it that
# combination does not link -- it overflows FLASH, and it never has fitted.
# MEASURED, against the linker's FLASH region so that the two halves are the
# same quantity (ld is what refuses first, before imgtool gets a chance):
#
#   thread+lto (debug, no client)   423,332 B used,  10,332 B region free
#   untrimmed CLIENT=1                               ld: overflowed by 5,300 B
#                                                    ---------
#   so the client role costs                          15,632 B
#
# and with this file applied the image was 430,000 B, which is 8,964 B of that
# bought back -- 1,929 B clear of the 431,929 B ceiling imgtool enforced before
# the single-slot sector count was pinned. See pm_static.yml for the derivation.
#
# RE-MEASURED 2026-08-23 at d8156563: 431,724 B used, 205 B clear under that old
# 128-sector check. `--max-sectors 1` raises the same image's signing clearance
# by 1,524 B without changing its bytes, to 1,729 B. That is still tight.
#
# WHAT WAS SPENT AND WHAT WAS FOUND getting the client working on hardware:
#
#   +2,392 B  the X.509 DER TBSCertificate converter, which is what makes a
#             real peer's certificate verifiable at all. Not optional and not
#             shrinkable: see matter_case.c.
#     +216 B  relocking the bound lock when this one relocks
#   -3,764 B  dead weight found while looking for room: OpenThread's ping
#             sender and uptime counter (no caller, and ot::Instance members so
#             --gc-sections can never drop them), and AES-CCM linked twice
#             because the 802.15.4 driver compiled its own copy while
#             OPENTHREAD_MAC_SOFTWARE_TX_SECURITY_ENABLE was already on
#     -~600 B per-datagram narration in matter_commission.c demoted to DBG
#
# THE LOG DEMOTIONS ARE RECOVERABLE AND THE FEATURE CUTS ARE NOT, which is the
# order to spend in. `matter_ble` at DBG brings every demoted line back. What
# stays at INF is anything reporting a DECISION -- writes, invokes, AddNOC, the
# CASE handshake, refusals, unsecured drops, and the LockState report line,
# which was demoted once and put back because rc is the only way to tell a dead
# subscription from one that never matched.
#
# THAT IS A NARROW FIT AND IT IS MEANT TO BE. This profile is not gated by a
# recorded baseline: at that much free it sits under the 8,192 B floor the other
# profiles are held to, and recording it would mean lowering that floor to fit
# the image, which is the one move `make cdk-size-baseline` refuses on purpose.
# The build failing to sign IS the gate here. If it fails, buy the bytes back
# below rather than raising the ceiling.
#
# The RELEASE image has room only because overlay-release.conf drops
# CONFIG_LOG_DEFAULT_LEVEL to 1, which that file measured at 20,568 B. Taking
# the same lever here would defeat the purpose: the reason to build a debug
# client image is to WATCH THE CLIENT, and a global level of 1 takes its lines
# along with everyone else's.
#
# So this trims by MODULE, against one question: can this line say anything
# about why a bound lock did or did not open? Everything that can, stays.
#
# ONLY FOUR SYMBOLS ARE AVAILABLE, and that is a property of the tree rather
# than a choice. A module gets a settable level only where a Kconfig declares
# one (`module = X` / `module-str = y`), and most do not: ultrawidelock_cred_uwb,
# thread_gate, ccc_shim and ultrawidelock_rng all register with a literal
# LOG_LEVEL_INF and cannot be turned down from a .conf file at all. Setting a
# level symbol that does not exist ABORTS the CMake configure rather than
# warning, so every symbol below was read out of a `module =` line first.
#
# WHAT STAYS, and why:
#
#   matter_client   the whole point: Sigma1/2/3, the resolve, the invoke, and
#                   every refusal reason. It has a log module of its own for
#                   exactly this -- see apps/dwm3001cdk-lock/Kconfig. Before that
#                   split it logged under matter_ble, and there was no way to
#                   buy flash from Matter without silencing the client too.
#   matter_ble      NOT trimmed. It carries commissioning and fabric handling,
#                   which is where "no second administrator" appears.
#   matter_thread   NOT trimmed either, and now a switch of its own: SRP
#                   registration and DNS-SD resolution, which is what explains
#                   "the bound lock did not resolve". It shared the matter_ble
#                   symbol until the split in apps/dwm3001cdk-lock/Kconfig, so
#                   quieting commissioning used to take this with it.
#
# WHAT GOES. All of these keep LOG_ERR, so a fault still announces itself; what
# goes is the INF/WRN narration around it.
#
#   ULTRAWIDELOCK_CRED   the biggest single trim, and the furthest from this
#                        question. Covers ultrawidelock_reader and
#                        ultrawidelock_ranging: the credential exchange and the
#                        ranging that gates it. A walk-up that never granted
#                        never reaches the client at all, and that case is
#                        diagnosed with this overlay off.
#   ULTRAWIDELOCK_DFU    firmware updates. Nothing to do with opening a door.
#   DW3000               the radio driver's own chatter.
#
# ULTRAWIDELOCK_NFC is NOT here, and the reason is worth keeping: its level
# symbol does not exist on this image. overlay-thread.conf configures the NFC
# transport out, so the `if ULTRAWIDELOCK_NFC` block that would declare
# ULTRAWIDELOCK_NFC_LOG_LEVEL never instantiates. Setting it aborted the CMake
# configure -- which is exactly the failure the note above describes, met on the
# first build of this file.
#
# IF YOU ARE DIAGNOSING ANY OF THOSE, this is the wrong image: build without
# CLIENT=1 and they all come back at INF, because then there is room for them.
#
# THE MARGIN IS THIN, so re-measure rather than assuming. When it stops fitting,
# the levers in the order they are worth taking:
#
#   1. HUNT DEAD WEIGHT FIRST. It was worth 3,764 B in 2026-08-23's search and
#      cost nothing at all -- two OpenThread modules with no caller and a
#      second copy of AES-CCM. Measure with nm on the ELF before assuming there
#      is none left; --gc-sections cannot drop a C++ object's members, so
#      "unused" and "not linked" are different questions.
#   2. Demote more narration to DBG, cheapest first, and only lines that report
#      bookkeeping rather than a decision.
#   3. Drop the patch_staging partition, worth 32,768 B on its own and costing
#      a debug board only the ability to receive an OTA delta nobody was going
#      to send it. Needs a second pm_static.yml, a guard on PM_PATCH_STAGING_ID
#      in ports/zephyr/osal/flash_zephyr.c, and mcuboot_CONFIG_ULTRAWIDELOCK_DFU_APPLIER=n
#      in mk/cdk.mk -- the bootloader references the partition too, and without
#      that it stops compiling.
#
# WHAT (3) REALLY COSTS, since it reads cheaper than it is: a board carrying the
# debug map cannot be moved to the release map by FOTA. There is no secondary
# slot on this part, so an update is an in-place delta staged in the partition
# being removed. The transition becomes wired-only, `west flash`, forever. Fine
# for a board on a desk with a J-Link on it; not fine for anything else.
# settings_storage stays at 0x7c000 either way, so fabrics, trust anchors and
# the reader key survive the move in both directions.
#
# TWO THINGS ARE NOT LEVERS, both measured 2026-08-22 rather than assumed:
# -Oz (CONFIG_SIZE_OPTIMIZATIONS_AGGRESSIVE) saves ONE BYTE over -Os on this
# GCC under LTO, and -flto-partition=one saves nothing attributable. Do not
# spend a build on either; see overlay-lto.conf.

# The client's own narration, at full verbosity. The one module this image
# exists to read.
CONFIG_ULTRAWIDELOCK_MATTER_CLIENT_LOG_LEVEL_DBG=y

# Errors only, from everything the client cannot be blamed on.
CONFIG_ULTRAWIDELOCK_CRED_LOG_LEVEL_ERR=y
CONFIG_ULTRAWIDELOCK_DFU_LOG_LEVEL_ERR=y
CONFIG_DW3000_LOG_LEVEL_ERR=y

# No step-up (a Watch learned from its Access Document) on this image: the one
# feature cut in this file, taken because RAM ran out and none of the levers
# above buy RAM. MEASURED 2026-09-10 at 543b930e, with it on: FLASH overflowed
# by 3,324 B and RAM by 2,496 B, the RAM half being step-up's static buffers
# (s_stepup_sd and s_learn_scratch at 1,536 B each, s_learn_doc at 1,312 B).
# Off, it linked but still missed signing by 34 B (the issuer store Matter
# needs stays), bought back by demoting three matter_ble startup lines that
# report a pass rather than a decision: both SRP sign self-test PASS lines and
# "0xFFF6 transport ready". Their failures still log at ERR.
# A Watch walk-up is diagnosed on the plain image, like the rest of
# ULTRAWIDELOCK_CRED above; a board carrying this image admits only the keys
# the hub sent.
CONFIG_ULTRAWIDELOCK_CRED_STEPUP=n
```

## overlay-client.conf
```kconfig
# The Matter CLIENT role: this lock opens ANOTHER Matter lock when the UWB gate
# fires. See docs/matter-binding.md.
#
# Additive. The node stays a full Door Lock server and everything it already
# does is unchanged; what this adds is the other direction. Off, not one byte of
# it is compiled, which is why it is an overlay rather than a default.
#
# MEASURED cost of the OpenThread DNS client this pulls in, on the
# thread+release+smp+lto image: 4,052 B of flash, 160 B of RAM. The client's own
# code is on top of that. Order it after overlay-release.conf so nothing it sets
# can be undone.
CONFIG_ULTRAWIDELOCK_MATTER_CLIENT=y

# No credential log lines at all, errors included: what keeps step-up (a Watch
# learned from its Access Document) on the release client image. MEASURED
# 2026-09-11 with step-up on, that image overflowed FLASH by 848 B, and a
# release image already logs errors only, so no lower level was left to take.
# The debug client image gets its credential errors back from
# overlay-client-debug.conf, which comes after this file.
CONFIG_ULTRAWIDELOCK_CRED_LOG_LEVEL_OFF=y
```

## src/rtt_bench.h
```c
/* SPDX-License-Identifier: ISC */

/*
 * rtt_bench.h - bench commands typed into the RTT terminal.
 *
 * The Matter image has no shell: RTT is its only console and the USB
 * provisioning console is compiled out (overlay-thread.conf). But RTT has a
 * down-buffer, and `make monitor` (probe-rs) feeds what you type at its
 * `Terminal>` prompt into down-buffer 0. This drains it for the one line the
 * ESP32 lock has always had as `ultrawidelock prov`:
 *
 *   prov    print identity, trust store, issuer keys, last-presented credential
 *
 * Bench only. A `trust` line (admit whichever credential was presented last)
 * lived here briefly for a second device on the owner's Apple ID, which the
 * hub never sends a SetCredential for; the reader now learns such a key from
 * the device's Access Document instead, and this image had no flash for both.
 */

#ifndef RTT_BENCH_H_
#define RTT_BENCH_H_

#ifdef __cplusplus
extern "C" {
#endif

/** Drain RTT down-buffer 0 and run any complete command line. Cheap when
 *  nothing is attached: one SEGGER_RTT_Read that returns 0. */
void rtt_bench_poll(void);

#ifdef __cplusplus
}
#endif

#endif /* RTT_BENCH_H_ */
```
